/*@!Encoding:1256*/
includes
{
  
}

variables
{

  int va[3];
  char index=0;
  char ultrasonic_flag[3];
  char flag=0;
  msTimer statuesTimer; 
  message Middle_ECU_Hello_statues statues;
  message Fast_decision_Message Decision;
  

}

on message MAIN_ECU4_Message
{

  if (this.byte(0)==0x00)
  {
       putValue(Move_left,0);
       putValue(Move_Right,0);
       putValue(Move_Ahead,0);
       putValue(Move_Stop,0);
    cancelTimer(statuesTimer);
  }
  else
  {
  setTimer(statuesTimer,300);
  }
}
on message Message_start
{
  
  if(this.`START==0x1)
  { 
    cancelTimer(statuesTimer);
    
  }
  else if(this.`START==0x00)
  {
    setTimer(statuesTimer,300);
  } 
}
void fast_decision()
{

  Decision.byte(7)=flag;
    switch(flag)
    {
         case 0x01:
        // printf("turn left \n" );
       putValue(Move_left,1);
       putValue(Move_Right,0);
       putValue(Move_Ahead,0);
       putValue(Move_Stop,0);

         break;
         case 0x02:
        //printf("turn left or right \n" );
       putValue(Move_left,1);
       putValue(Move_Right,1);
       putValue(Move_Ahead,0);
       putValue(Move_Stop,0);

         break;
         case 0x03:
        // printf("turn left \n" );
       putValue(Move_left,1);
       putValue(Move_Right,0);
       putValue(Move_Ahead,0);
       putValue(Move_Stop,0);

         break;
         case 0x04:
        // printf("turn right \n" );
       putValue(Move_left,0);
       putValue(Move_Right,1);
       putValue(Move_Ahead,0);
       putValue(Move_Stop,0);
   
         break;
         case 0x05:
        // printf("go a head \n" );
       putValue(Move_left,0);
       putValue(Move_Right,0);
       putValue(Move_Ahead,1);
       putValue(Move_Stop,0);

         break;
         case 0x06:
        // printf("turn right \n" );
       putValue(Move_left,0);
       putValue(Move_Right,1);
       putValue(Move_Ahead,0);
       putValue(Move_Stop,0);

         break;
       case 0x07:
        // printf("turn right \n" );
       putValue(Move_left,0);
       putValue(Move_Right,0);
       putValue(Move_Ahead,0);
       putValue(Move_Stop,1);

         break;
         default:
       putValue(Move_left,0);
       putValue(Move_Right,0);
       putValue(Move_Ahead,0);
       putValue(Move_Stop,1);

      
   }
  
  output(Decision);
  flag=0;
  
}
void compare(char channel)
{
if(va[channel]>=100)
{
  write("Very safe distance Ultrasonic %d",channel);
}
else if((va[channel]<100)&(50<=va[channel]))
{
   write("Critical distance Ultrasonic %d take fast decision",channel);
  flag=flag|(1<<channel);
}
else
{
  write("Dangerous distance Ultrasonic %d stop the car",channel);
  flag=flag|(1<<channel+5);
}  
  
}

on message Ultrasonic_state
{

  va[0]=this.Ultrasonic_F_left;
  va[1]=this.Ultrasonic_F_Middle;
  va[2]=this.Ultrasonic_F_Right;

compare(0);
compare(1);
compare(2);
fast_decision();
}
on envVar Middle_ECU_statues
{
  
  if(getValue(Middle_ECU_statues)==1)
  {
    statues.Middle_ECU_Hello= 1;
    output(statues);
  }
  else
  {

    statues.Middle_ECU_Hello= 0;
    output(statues);
  }
}

on timer statuesTimer
{
  setTimer(statuesTimer,300);
     output(statues);
  
}